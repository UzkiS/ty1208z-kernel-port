// SPDX-License-Identifier: GPL-2.0-only
#include "hi3798mv100-ty1208z-diagnostic.dts"

/ {
	model = "TY1208Z CA inherited Ethernet audit";
};

&{/soc} {
	ethernet-audit@f9840000 {
		compatible = "tianyi,ty1208z-ethernet-audit";
		reg = <0xf9840000 0x4000>, <0xf8a220cc 4>, <0xf8a22120 4>,
		      <0xf8a20008 4>, <0xf8a20118 4>, <0xf8a20844 4>;
		reg-names = "mac", "crg51", "phy-crg", "phy-select", "phy-address", "phy-ldo";
	};
};
